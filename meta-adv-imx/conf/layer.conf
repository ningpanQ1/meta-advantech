## meta-adv-imx/conf/layer.conf
```bitbake
# We have a conf and classes directory, add to BBPATH
BBPATH .= ":${LAYERDIR}"

# We have a packages directory, add to BBFILES
BBFILES += "${LAYERDIR}/recipes-*/*/*.bb \
            ${LAYERDIR}/recipes-*/*/*.bbappend"

BBFILE_COLLECTIONS += "adv-imx-bsp"
BBFILE_PATTERN_adv-imx-bsp := "^${LAYERDIR}/"
BBFILE_PRIORITY_adv-imx-bsp = "16"
LAYERSERIES_COMPAT_adv-imx-bsp = "kirkstone"
LAYERDEPENDS_adv-imx-bsp = "fsl-bsp-release fsl-sdk-release freescale-layer"

BBMASK += "meta-freescale-3rdparty/recipes-bsp/atf/qoriq-atf_1.5.bbappend"
BBMASK += "meta-freescale-3rdparty/recipes-kernel/linux/linux-qoriq_5.4.bbappend"

# Define new EULAs and add them to the list defined in meta-freescale.
# See fsl-eula-unpack.bbclass.
FSL_EULA_FILE_MD5SUM_LA_OPT_NXP_SOFTWARE_LICENSE_V27 = "e565271ec9a80ce47abbddc4bffe56fa"
FSL_EULA_FILE_MD5SUM_LA_OPT_NXP_SOFTWARE_LICENSE_V29 = "28241cb895217d7946e40e7227136d02"
FSL_EULA_FILE_MD5SUM_LA_OPT_NXP_SOFTWARE_LICENSE_V30 = "03bcadc8dc0a788f66ca9e2b89f56c6f"
FSL_EULA_FILE_MD5SUM_LA_OPT_NXP_SOFTWARE_LICENSE_V31 = "dedee5689786754f61ea3a76035c8a81"
FSL_EULA_FILE_MD5SUM_LA_OPT_NXP_SOFTWARE_LICENSE_V32 = "17d2319de7baa686e8a755ba58a9ebf5"
FSL_EULA_FILE_MD5SUM_LA_OPT_NXP_SOFTWARE_LICENSE_V33 = "e4098ac4459cb81b07d3f0c22b3e8370"
FSL_EULA_FILE_MD5SUM_LA_OPT_NXP_SOFTWARE_LICENSE_V34 = "be5ff43682ed6c57dfcbeb97651c2829"
FSL_EULA_FILE_MD5SUM_LA_OPT_NXP_SOFTWARE_LICENSE_V35 = "d3c315c6eaa43e07d8c130dc3a04a011"

FSL_EULA_FILE_MD5SUMS:append = " \
    ${FSL_EULA_FILE_MD5SUM_LA_OPT_NXP_SOFTWARE_LICENSE_V27} \
    ${FSL_EULA_FILE_MD5SUM_LA_OPT_NXP_SOFTWARE_LICENSE_V29} \
    ${FSL_EULA_FILE_MD5SUM_LA_OPT_NXP_SOFTWARE_LICENSE_V30} \
    ${FSL_EULA_FILE_MD5SUM_LA_OPT_NXP_SOFTWARE_LICENSE_V31} \
    ${FSL_EULA_FILE_MD5SUM_LA_OPT_NXP_SOFTWARE_LICENSE_V32} \
    ${FSL_EULA_FILE_MD5SUM_LA_OPT_NXP_SOFTWARE_LICENSE_V33} \
    ${FSL_EULA_FILE_MD5SUM_LA_OPT_NXP_SOFTWARE_LICENSE_V34} \
    ${FSL_EULA_FILE_MD5SUM_LA_OPT_NXP_SOFTWARE_LICENSE_V35} \
"

# Override the EULA defined in meta-freescale.
FSL_EULA_FILE = "${LAYERDIR}/../../meta-imx/EULA.txt"
FSL_EULA_FILE_MD5SUM = "${FSL_EULA_FILE_MD5SUM_LA_OPT_NXP_SOFTWARE_LICENSE_V35}"

HOSTTOOLS_NONFATAL:append = " bc rsync xxd"

# optee is no longer a valid distro feature. Use machine feature to remove, like this:
# MACHINE_FEATURES:remove = "optee"
# DEPRECATED: The ability to remove optee from the build is deprecated and
# will be removed in some future release.

MACHINE_USES_VIVANTE_KERNEL_DRIVER_MODULE ?= "0"

# Override for use-imx-security-controller-firmware.bbclass
SECO_FIRMWARE_NAME:mx8ulp-nxp-bsp = "mx8ulpa0-ahab-container.img"
SECO_FIRMWARE_NAME:mx8dxla1-nxp-bsp = "mx8dxla1-ahab-container.img"
SECO_FIRMWARE_NAME:mx8dxlb0-nxp-bsp = "mx8dxlb0-ahab-container.img"

# Overrides for imx-base.inc
IMX_DEFAULT_BSP = "nxp"

# The default bootloader is set to -fslc in
# meta-freescale/cond/machine/include/imx-base.inc, so we must
# override it here.
IMX_DEFAULT_BOOTLOADER:imx-nxp-bsp = "u-boot-imx"

UBOOT_MAKE_TARGET:pn-u-boot-imx:mx6-nxp-bsp = "u-boot.imx"
UBOOT_MAKE_TARGET:pn-u-boot-imx:mx7-nxp-bsp = "u-boot.imx"
UBOOT_SUFFIX:pn-u-boot-imx:mx6-nxp-bsp = "imx"
UBOOT_SUFFIX:pn-u-boot-imx:mx7-nxp-bsp = "imx"
UBOOT_SUFFIX:pn-u-boot-imx:mx8-nxp-bsp = "bin"
UBOOT_MAKE_TARGET:pn-u-boot-imx-mfgtool:mx6-nxp-bsp = "u-boot.imx"
UBOOT_MAKE_TARGET:pn-u-boot-imx-mfgtool:mx7-nxp-bsp = "u-boot.imx"
UBOOT_SUFFIX:pn-u-boot-imx-mfgtool:mx6-nxp-bsp = "imx"
UBOOT_SUFFIX:pn-u-boot-imx-mfgtool:mx7-nxp-bsp = "imx"
UBOOT_SUFFIX:pn-u-boot-imx-mfgtool:mx8-nxp-bsp = "bin"

IMX_DEFAULT_UBOOTTOOLS = "u-boot-imx-tools"
PREFERRED_PROVIDER_u-boot-tools-native = "${IMX_DEFAULT_UBOOTTOOLS}-native"
PREFERRED_PROVIDER_nativesdk-u-boot-tools = "nativesdk-${IMX_DEFAULT_UBOOTTOOLS}"
PREFERRED_PROVIDER_u-boot-mkimage-native = "${IMX_DEFAULT_UBOOTTOOLS}-native"
PREFERRED_PROVIDER_nativesdk-u-boot-mkimage = "nativesdk-${IMX_DEFAULT_UBOOTTOOLS}"

# Avoid multiple runtime providers for u-boot-default-env
PREFERRED_RPROVIDER_u-boot-default-env ??= "${IMX_DEFAULT_BOOTLOADER}"

MACHINE_SOCARCH_FILTER:remove = "alsa-lib gstreamer1.0 imx-codec"

# Use latest SDMA firmware from firmware-imx instead of upstream linux-firmware
MACHINE_FIRMWARE:remove:mx6-nxp-bsp      = "linux-firmware-imx-sdma-imx6q"
MACHINE_FIRMWARE:remove:mx7d-nxp-bsp     = "linux-firmware-imx-sdma-imx7d"
MACHINE_FIRMWARE:remove:mx8-nxp-bsp      = "linux-firmware-imx-sdma-imx7d"
MACHINE_FIRMWARE:append:mx6-nxp-bsp      = " firmware-imx-sdma-imx6q"
MACHINE_FIRMWARE:append:mx7-nxp-bsp      = " firmware-imx-sdma-imx7d"
# imx6ul7d doesn't have mx7 in MACHINEOVERRIDES but needs both imx6q and imx7d firmware

MACHINE_FIRMWARE:append:imx6ul7d = " firmware-imx-sdma-imx7d"
MACHINE_FIRMWARE:append:mx8-nxp-bsp      = " firmware-imx-sdma-imx7d"

MACHINE_FIRMWARE:append:mx6ulz-nxp-bsp = " firmware-imx-epdc"
MACHINE_FIRMWARE:append:mx8-nxp-bsp    = " linux-firmware-ath10k"
MACHINE_FIRMWARE:append:mx8qm-nxp-bsp  = " firmware-imx-vpu-imx8 firmware-imx-hdmi firmware-imx-xuvi-imx8 sof-imx sof-zephyr zephyr-demo-imx"
MACHINE_FIRMWARE:remove:mx8qxp-nxp-bsp = "firmware-imx-vpu-imx8qxp"
MACHINE_FIRMWARE:append:mx8qxp-nxp-bsp = " firmware-imx-vpu-imx8 sof-imx sof-zephyr zephyr-demo-imx"
MACHINE_FIRMWARE:remove:mx8dx-nxp-bsp  = "firmware-imx-vpu-imx8qxp"
MACHINE_FIRMWARE:append:mx8dx-nxp-bsp  = " firmware-imx-vpu-imx8 sof-imx sof-zephyr"
MACHINE_FIRMWARE:append:mx8mn-nxp-bsp  = " firmware-imx-easrc-imx8mn"
MACHINE_FIRMWARE:append:mx8mnul-nxp-bsp = " firmware-imx-easrc-imx8mn"
MACHINE_FIRMWARE:remove:mx8mp-nxp-bsp  = "firmware-sof-imx"
MACHINE_FIRMWARE:append:mx8mp-nxp-bsp  = " sof-imx sof-zephyr zephyr-demo-imx"
MACHINE_FIRMWARE:remove:mx8mpul-nxp-bsp  = "firmware-sof-imx"
MACHINE_FIRMWARE:append:mx8mpul-nxp-bsp  = " sof-imx sof-zephyr"
MACHINE_FIRMWARE:append:mx8ulp-nxp-bsp = " sof-imx sof-zephyr"

# NXP WiFi firmware & extra Wlan SDK
MACHINE_FIRMWARE:append = " ${@bb.utils.contains('MACHINE_FEATURES', 'nxp8987', 'linux-firmware-nxp89xx', '', d)}"
MACHINE_FIRMWARE:append = " ${@bb.utils.contains('MACHINE_FEATURES', 'nxp8997', 'linux-firmware-nxp89xx', '', d)}"
MACHINE_EXTRA_RRECOMMENDS:append = " ${@bb.utils.contains('MACHINE_FEATURES', 'nxp8987', 'nxp-wlan-sdk kernel-module-nxp89xx', '', d)}"
MACHINE_EXTRA_RRECOMMENDS:append = " ${@bb.utils.contains('MACHINE_FEATURES', 'nxp8997', 'nxp-wlan-sdk kernel-module-nxp89xx', '', d)}"

# MCore Demo apps to /lib/firmware
MACHINE_EXTRA_RRECOMMENDS:append:mx7ulp-nxp-bsp  = " imx-m4-demos"
MACHINE_EXTRA_RRECOMMENDS:append:mx8mm-nxp-bsp   = " imx-m4-demos"
MACHINE_EXTRA_RRECOMMENDS:append:mx8mn-nxp-bsp   = " imx-m7-demos"
MACHINE_EXTRA_RRECOMMENDS:append:mx8mnul-nxp-bsp = " imx-m7-demos"
MACHINE_EXTRA_RRECOMMENDS:append:mx8mp-nxp-bsp   = " imx-m7-demos"
MACHINE_EXTRA_RRECOMMENDS:append:mx8mpul-nxp-bsp = " imx-m7-demos"
MACHINE_EXTRA_RRECOMMENDS:append:mx8mq-nxp-bsp   = " imx-m4-demos"
MACHINE_EXTRA_RRECOMMENDS:append:mx8qm-nxp-bsp   = " imx-m4-demos"
MACHINE_EXTRA_RRECOMMENDS:append:mx8qxp-nxp-bsp  = " imx-m4-demos"
MACHINE_EXTRA_RRECOMMENDS:append:mx8dx-nxp-bsp   = " imx-m4-demos"
MACHINE_EXTRA_RRECOMMENDS:append:mx8dxl-nxp-bsp  = " imx-m4-demos"

MACHINE_GSTREAMER_1_0_PLUGIN:mx6dl-nxp-bsp ?= "imx-gst1.0-plugin"
MACHINE_GSTREAMER_1_0_PLUGIN:mx6q-nxp-bsp ?= "imx-gst1.0-plugin"
MACHINE_GSTREAMER_1_0_PLUGIN:mx6sl-nxp-bsp ?= "imx-gst1.0-plugin"
MACHINE_GSTREAMER_1_0_PLUGIN:mx6sll-nxp-bsp ?= "imx-gst1.0-plugin"
MACHINE_GSTREAMER_1_0_PLUGIN:mx6sx-nxp-bsp ?= "imx-gst1.0-plugin"
MACHINE_GSTREAMER_1_0_PLUGIN:mx6ul-nxp-bsp ?= "imx-gst1.0-plugin"
MACHINE_GSTREAMER_1_0_PLUGIN:mx6ull-nxp-bsp ?= "imx-gst1.0-plugin"
MACHINE_GSTREAMER_1_0_PLUGIN:mx6ulz-nxp-bsp ?= "imx-gst1.0-plugin"
MACHINE_GSTREAMER_1_0_PLUGIN:mx7d-nxp-bsp ?= "imx-gst1.0-plugin"
MACHINE_GSTREAMER_1_0_PLUGIN:mx7ulp-nxp-bsp ?= "imx-gst1.0-plugin"
MACHINE_GSTREAMER_1_0_PLUGIN:mx8-nxp-bsp ?= "imx-gst1.0-plugin"
MACHINE_GSTREAMER_1_0_PLUGIN:mx9-nxp-bsp ?= "imx-gst1.0-plugin"

PREFERRED_VERSION_weston:mx6-nxp-bsp ?= "10.0.0.imx"
PREFERRED_VERSION_weston:mx7-nxp-bsp ?= "10.0.0.imx"
PREFERRED_VERSION_weston:mx8-nxp-bsp ?= "10.0.0.imx"
PREFERRED_VERSION_weston:mx9-nxp-bsp ?= "10.0.0.imx"

PREFERRED_VERSION_wayland-protocols:mx6-nxp-bsp = "1.25.imx"
PREFERRED_VERSION_wayland-protocols:mx7-nxp-bsp = "1.25.imx"
PREFERRED_VERSION_wayland-protocols:mx8-nxp-bsp = "1.25.imx"
PREFERRED_VERSION_wayland-protocols:mx9-nxp-bsp = "1.25.imx"

PREFERRED_VERSION_libdrm:mx6-nxp-bsp ?= "2.4.109.imx"
PREFERRED_VERSION_libdrm:mx7-nxp-bsp ?= "2.4.109.imx"
PREFERRED_VERSION_libdrm:mx8-nxp-bsp ?= "2.4.109.imx"
PREFERRED_VERSION_libdrm:mx9-nxp-bsp ?= "2.4.109.imx"

# Note: The OpenCV recipe for the i.MX fork is not compatible with i.MX 6 or 7
PREFERRED_VERSION_opencv:mx8-nxp-bsp ?= "4.5.4.imx"

PREFERRED_VERSION_optee-client:mx6-nxp-bsp = "3.17.0.imx"
PREFERRED_VERSION_optee-client:mx7-nxp-bsp = "3.17.0.imx"
PREFERRED_VERSION_optee-client:mx8-nxp-bsp = "3.17.0.imx"
PREFERRED_VERSION_optee-os:mx6-nxp-bsp = "3.17.0.imx"
PREFERRED_VERSION_optee-os:mx7-nxp-bsp = "3.17.0.imx"
PREFERRED_VERSION_optee-os:mx8-nxp-bsp = "3.17.0.imx"
PREFERRED_VERSION_optee-test:mx6-nxp-bsp = "3.17.0.imx"
PREFERRED_VERSION_optee-test:mx7-nxp-bsp = "3.17.0.imx"
PREFERRED_VERSION_optee-test:mx8-nxp-bsp = "3.17.0.imx"

IMX_DEFAULT_KERNEL:mx6ulz-nxp-bsp = "linux-imx"

SOC_DEFAULT_IMAGE_FSTYPES_IMX_REMOVALS ?= "wic.gz"
SOC_DEFAULT_IMAGE_FSTYPES:remove = "${SOC_DEFAULT_IMAGE_FSTYPES_IMX_REMOVALS}"
SOC_DEFAULT_IMAGE_FSTYPES:append = " wic.bz2 tar.bz2"

OPTEE_BOOT_IMAGE:mx6-nxp-bsp ?= "tee.bin uTee-${OPTEE_BIN_EXT}"
OPTEE_BOOT_IMAGE:mx7-nxp-bsp ?= "tee.bin uTee-${OPTEE_BIN_EXT}"
OPTEE_BOOT_IMAGE:mx8-nxp-bsp ?= "tee.bin"

IMAGE_INSTALL:append = " \
    ${@bb.utils.contains('COMBINED_FEATURES', 'jailhouse', 'jailhouse', '', d)} \
    ${@bb.utils.contains('MACHINE_FEATURES', 'optee', 'packagegroup-fsl-optee-imx', '', d)} \
"
MACHINE_FEATURES:remove ?= "mrvl8997"
```

## meta-adv-imx/conf/machine/imx8mmeamb9918a1.conf
```bitbake
#@TYPE: Machine
#@NAME: Advantech i.MX8MM LPDDR4 EAMB9918 A1
#@SOC: i.MX8MM
#@DESCRIPTION: Machine configuration for Advantech i.MX8MM LPDDR4 EAMB9918 Board
#@MAINTAINER: jwzl <cnj1990@sina.com.cn>

MACHINEOVERRIDES =. "adv-bsp:imx-boot-container:mx8:mx8m:mx8mm:"

require conf/machine/include/imx-base.inc
require conf/machine/include/tune-cortexa53.inc

MACHINE_FEATURES += "pci wifi bluetooth"

# OP-TEE is also applicable to NXP BSP, mainline BSP seems not to have
# a full support for it yet.
MACHINE_FEATURES:append:use-nxp-bsp = " optee"

# Set kernel DTB
KERNEL_DEVICETREE = " \
	freescale/imx8mm-evk.dtb \
	freescale/imx8mm-adv-eamb9918-a1.dtb \
"

# Set u-boot DTB
UBOOT_DTB_NAME = "imx8mm-adv-eamb9918-a1.dtb"

# uboot binary.
IMX_DEFAULT_BOOTLOADER = "u-boot-imx"
UBOOT_SUFFIX = "bin"
SPL_BINARY = "spl/u-boot-spl.bin"
LOADADDR = ""
UBOOT_MAKE_TARGET = "all"
IMX_BOOT_SEEK = "33"

# uboot config
UBOOT_CONFIG ??= "sd"
UBOOT_CONFIG[sd]       = "imx8mm_adv_eamb9918_2g_defconfig,sdcard"
UBOOT_CONFIG[mfgtool]  = "imx8mm_adv_eamb9918_2g_defconfig"
UBOOT_CONFIG[fspi]   = "imx8mm_adv_eamb9918_2g_defconfig"

# Set DDR FIRMWARE
DDR_FIRMWARE_NAME = " \
	lpddr4_pmu_train_1d_imem.bin \
	lpddr4_pmu_train_1d_dmem.bin \
	lpddr4_pmu_train_2d_imem.bin \
	lpddr4_pmu_train_2d_dmem.bin \
"

# Set imx-mkimage boot target
IMXBOOT_TARGETS = "${@bb.utils.contains('UBOOT_CONFIG', 'fspi', 'flash_evk_flexspi', 'flash_evk', d)}"
IMX_BOOT_SOC_TARGET = "iMX8MM"

ATF_PLATFORM = "imx8mm"
ATF_LOAD_ADDR = "0x920000"
OPTEE_BIN_EXT = "8mm"
TEE_LOAD_ADDR = "0xbe000000"

# Extra firmware package name, that is required to build boot container for fslc bsp
IMX_EXTRA_FIRMWARE = "firmware-imx-8m"

# serial debug port settting
SERIAL_CONSOLES = "115200;ttymxc1"

# advantech default WKS file for sdcard/emmc parttion image.
WKS_FILE = "adv-imx-image-bootpart.wks.in"
WKS_FILE_DEPENDS:append = " imx-m4-demos"
IMAGE_BOOT_FILES:append = " \
    imx8mm_m4_TCM_hello_world.bin \
    imx8mm_m4_TCM_rpmsg_lite_pingpong_rtos_linux_remote.bin \
    imx8mm_m4_TCM_rpmsg_lite_str_echo_rtos.bin \
    imx8mm_m4_TCM_sai_low_power_audio.bin \
"

IMAGE_RELEASE_VERSION = "eamb9918-sdcard_2.0.0"

## Override the hostname.
hostname:pn-base-files = "eamb9918"

# append WIFI and Bluetooth module
IMAGE_INSTALL:append = "rs9116nb0"
```
